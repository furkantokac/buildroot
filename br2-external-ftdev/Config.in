## br2-external-ftdev/configs/ftdev_tk1_minimal_defconfig
```kconfig
BR2_arm=y
BR2_cortex_a15=y
BR2_DL_DIR="$(HOME)/.dl"
BR2_GLOBAL_PATCH_DIR="$(BR2_EXTERNAL)/patches/br16.05"
BR2_PACKAGE_HOST_LINUX_HEADERS_CUSTOM_3_10=y
BR2_TOOLCHAIN_BUILDROOT_GLIBC=y
BR2_TOOLCHAIN_BUILDROOT_CXX=y
BR2_ROOTFS_DEVICE_CREATION_DYNAMIC_EUDEV=y
BR2_TARGET_GENERIC_GETTY_PORT="ttyS0"
BR2_ROOTFS_OVERLAY="$(BR2_EXTERNAL)/board/tk1/rootfs_overlay"
BR2_ROOTFS_POST_BUILD_SCRIPT="$(BR2_EXTERNAL)/board/tk1/post-build.sh"
BR2_ROOTFS_POST_IMAGE_SCRIPT="$(BR2_EXTERNAL)/board/tk1/post-image.sh"
BR2_LINUX_KERNEL=y
BR2_LINUX_KERNEL_CUSTOM_GIT=y
BR2_LINUX_KERNEL_CUSTOM_REPO_URL="git://git.toradex.com/linux-toradex.git"
BR2_LINUX_KERNEL_CUSTOM_REPO_VERSION="ad44961f8b3cf5ce342d234c7eca05d89369c26b"
BR2_LINUX_KERNEL_PATCH="$(BR2_EXTERNAL)/board/tk1/kernel_patches"
BR2_LINUX_KERNEL_USE_CUSTOM_CONFIG=y
BR2_LINUX_KERNEL_CUSTOM_CONFIG_FILE="$(BR2_EXTERNAL)/board/tk1/custom_files/ftdev-linux_defconfig"
BR2_LINUX_KERNEL_DTS_SUPPORT=y
BR2_LINUX_KERNEL_INTREE_DTS_NAME="tegra124-apalis-v1.2-eval tegra124-apalis-eval"
BR2_LINUX_KERNEL_INSTALL_TARGET=y
BR2_PACKAGE_MESA3D=y
BR2_PACKAGE_MESA3D_DRI_DRIVER_SWRAST=y
BR2_PACKAGE_MESA3D_OPENGL_ES=y
BR2_PACKAGE_XORG7=y
BR2_PACKAGE_XSERVER_XORG_SERVER=y
BR2_PACKAGE_LIBXKBCOMMON=y
BR2_PACKAGE_IPROUTE2=y
BR2_TARGET_ROOTFS_EXT2=y
BR2_TARGET_ROOTFS_EXT2_4=y
BR2_PACKAGE_HOST_GENIMAGE=y
BR2_PACKAGE_NVIDIA_DRIVERS=y
```

## br2-external-ftdev/package/Config.in
```kconfig
source "$BR2_EXTERNAL/package/l4t/Config.in"
source "$BR2_EXTERNAL/package/lib/Config.in"
source "$BR2_EXTERNAL/package/extra/Config.in"
source "$BR2_EXTERNAL/package/fonts/Config.in"
```

## br2-external-ftdev/package/extra/Config.in
```kconfig
source "$BR2_EXTERNAL/package/extra/cbootimage-configs/Config.in"
source "$BR2_EXTERNAL/package/extra/dfu-programmer/Config.in"
source "$BR2_EXTERNAL/package/extra/eeupdate32/Config.in"
source "$BR2_EXTERNAL/package/extra/fastboot-write/Config.in"
source "$BR2_EXTERNAL/package/extra/nodm/Config.in"
source "$BR2_EXTERNAL/package/extra/irqbalance-imx/Config.in"
source "$BR2_EXTERNAL/package/extra/kexec-bootloader/Config.in"
source "$BR2_EXTERNAL/package/extra/qemu-i386-libc/Config.in"
source "$BR2_EXTERNAL/package/extra/cuda-debayer/Config.in"
```

## br2-external-ftdev/package/extra/cbootimage-configs/Config.in
```kconfig
menuconfig BR2_PACKAGE_CBOOTIMAGE_CONFIGS
	bool "cbootimage-configs"
	select BR2_PACKAGE_HOST_CBOOTIMAGE
	depends on BR2_TARGET_UBOOT
	help
	  The cbootimage-configs project contains cbootimage configuration
	  files for many Tegra boards, both those designed by NVIDIA, and
	  various third-parties.

	  https://github.com/NVIDIA/cbootimage-configs


if BR2_PACKAGE_CBOOTIMAGE_CONFIGS

config BR2_PACKAGE_CBOOTIMAGE_CONFIGS_BUILD
	string "board configuration"
	help
	  The full path of a configuration inside cbootimage-configs that is
	  to be built for the board you want to use. The file directory
	  structure usually is <soc>/<vendor>/<board>
	  Example for Jetson TK1:
	  tegra124/nvidia/jetson-tk1

config BR2_PACKAGE_CBOOTIMAGE_CONFIGS_BCT
	string "bct filename"
	help
	  The name of the bct generated by cbootimage for the selected
	  cbootimage configuration. If unsure look it up from the Makefile in
	  the specified board directory.

config BR2_PACKAGE_CBOOTIMAGE_CONFIGS_IMG
	string "img filename"
	help
	  The name of the image generated by cbootimage for the selected
	  cbootimage configuration. If unsure look it up from the Makefile in
	  the specified board directory.

	  Specify the filename without its extension. The extension is
	  automatically appended, according to what image type (signed or
	  unsigned) is built.

config BR2_PACKAGE_CBOOTIMAGE_CONFIGS_IMG_KEY
	string "pkc file to sign image for secureboot"
	help
	  Sign the image using a provided ssl key. This makes it possible to
	  run the image in secureboot environments with the matching key being
	  burned to the tegra fuses.
	  Be aware that the generated image will have the extension simg
	  instead of img if signing is enabled.

	  Compatible key files can be generated with openssl:
	  openssl genrsa -out rsa_priv.pem 2048

config BR2_PACKAGE_CBOOTIMAGE_CONFIGS_GENERATE_FLASHER
	bool "generate self-contained u-boot flasher"
	help
	  Generate an image consisting of a u-boot to flash the actual target
	  u-boot. For this a u-boot with a customized environment is generated
	  that contains a bootcmd to copy a target image into mmc. The actual
	  target u-boot, which is specified in BR2_PACKAGE_CBOOTIMAGE_CONFIGS_IMG is
	  appended to that image so that one self-contained image is generated
	  that can be flashed with tegrarcm.

if BR2_PACKAGE_CBOOTIMAGE_CONFIGS_GENERATE_FLASHER

config BR2_PACKAGE_CBOOTIMAGE_CONFIGS_FLASHER_GPT_FILE
	string "gpt partition table file"
	default "$(BR2_EXTERNAL)/package/extra/cbootimage-configs/gpt-table"
	help
	  Optionally provide a file that contains the partition table to
	  write to mmc.  Use format as specified in u-boot's README.gpt
	  documentation file.

	  Make sure to escape variables properly, as u-boot shall not evaluate
	  the variables when setting the environment variable, but only when
	  running the gpt command.

	  Example file content:
	  uuid_disk=\$\{disk_uuid\};name=rootfs,size=2000MiB,uuid=\$\{rootfs_uuid\};name=data,size=-,uuid=\$\{data_uuid\}

config BR2_PACKAGE_CBOOTIMAGE_CONFIGS_FLASHER_DFU_MAP
	string "enter dfu mode with map"
	default "rootfs part 0 1"
	help
	  Put the device in DFU mode on usb 0 and mmc 0, so that filesystem
	  images can be flashed to the device instantly.

	  This field contains the mapping scheme for partitions to DFU unit
	  names according to u-boot documentation README.dfutftp variable
	  dfu_alt_info.

	  Example:
	  rootfs part 0 1;data part 0 2

config BR2_PACKAGE_CBOOTIMAGE_CONFIGS_FLASHER_EXTRA_BOOTCMD
	string "u-boot flasher bootcmd extras"
	help
	  Specify extra bootcmds you want the u-boot flasher instance to run
	  before resetting the board. For example this could be setting the
	  board environment variable.
endif

endif
```

## br2-external-ftdev/package/extra/cuda-debayer/Config.in
```kconfig
config BR2_PACKAGE_CUDA_DEBAYER
	bool "cuda-debayer"
	select BR2_PACKAGE_CUDA
	select BR2_PACKAGE_CUDA_DEBAYER_GL if BR2_PACKAGE_HAS_LIBGL && !BR2_PACKAGE_CUDA_DEBAYER_OPENCV
	select BR2_PACKAGE_CUDA_DEBAYER_OPENCV if !BR2_PACKAGE_HAS_LIBGL
	depends on BR2_HOST_CUDA_CROSS_TOOLCHAIN

	help
	  A debayer image conversion tool using CUDA for accelerated
	  operation.

if BR2_PACKAGE_CUDA_DEBAYER

config BR2_PACKAGE_CUDA_DEBAYER_GL
	bool "Enable GL rendering"
	default y
	select BR2_PACKAGE_LIBGLU
	select BR2_PACKAGE_LIBGLEW
	select BR2_PACKAGE_LIBFREEGLUT
	depends on BR2_PACKAGE_HAS_LIBGL

comment "cuda-debayer GL backend requires libgl"
	depends on !BR2_PACKAGE_HAS_LIBGL

config BR2_PACKAGE_CUDA_DEBAYER_OPENCV
	bool "Enable OpenCV rendering"
	default n
	select BR2_PACKAGE_OPENCV4TEGRA

endif

comment "cuda-debayer requires cuda cross-compiling host toolchain"
	depends on !BR2_HOST_CUDA_CROSS_TOOLCHAIN
```

## br2-external-ftdev/package/extra/dfu-programmer/Config.in
```kconfig
config BR2_PACKAGE_DFU_PROGRAMMER
	bool "dfu-programmer"
	select BR2_PACKAGE_LIBUSB
	help
	  dfu-programmer is a multi-platform command-line programmer for Atmel
	  (8051, AVR, XMEGA & AVR32) chips with a USB bootloader supporting ISP.
	  Most Atmel devices having a USB port come pre-programmed with the
	  bootloader, and this is a lightweight alternative to Atmel's own
	  FLIP/BatchISP program. This is a mostly Device Firmware Update (DFU)
	  1.0 compliant user-space application.

	  https://dfu-programmer.github.io/
```

## br2-external-ftdev/package/extra/eeupdate32/Config.in
```kconfig
config BR2_PACKAGE_EEUPDATE32
	bool "eeupdate32"
	select BR2_PACKAGE_QEMU_I386_LIBC if !BR2_i386
	select BR2_PACKAGE_QEMU if !BR2_i386
	help
	  Intel eeprom update utility for ethernet controllers.

	  The binary installed by this package is not publicly available.
	  Please contact your Intel support representative to get access to
	  the eeupdate32 binary, if required.
```

## br2-external-ftdev/package/extra/fastboot-write/Config.in
```kconfig
config BR2_PACKAGE_FASTBOOT_WRITE
	bool "fastboot-write"
	help
	  A small tool to write fastboot image to a block device. Typically
	  fastboot image are written from the bootloader using an external
	  programming system connected via USB. This tool instead allow to
	  write the images in-system.
```

## br2-external-ftdev/package/extra/irqbalance-imx/Config.in
```kconfig
config BR2_PACKAGE_IRQBALANCE_IMX
	bool "irqbalance-imx"
	depends on BR2_arm
	depends on !BR2_PACKAGE_IRQBALANCE
	help
	  Irqbalance is a daemon to help balance the cpu load generated
	  by interrupts across all of a systems cpus.
	  Irqbalance identifies the highest volume interrupt sources,
	  and isolates them to a single unique cpu, so that load is
	  spread as much as possible over an entire processor set, while
	  minimizing cache hit rates for irq handlers.

	  The standard upstream package is broken on ARM; this package
	  is a fork that's working on that platform.

	  https://github.com/dv1/irqbalanced

comment "irqbalance-imx conflicts with irqbalance"
	depends on BR2_arm
	depends on BR2_PACKAGE_IRQBALANCE
```

## br2-external-ftdev/package/extra/kexec-bootloader/Config.in
```kconfig
config BR2_PACKAGE_KEXEC_BOOTLOADER
	bool "kexec-bootloader"
	select BR2_PACKAGE_SDL
	select BR2_PACKAGE_SDL_FBCON
	select BR2_PACKAGE_SDL_TTF
	select BR2_PACKAGE_FONTCONFIG
	help
	  A simple Linux-based bootloader that presents the user
	  alternative Linux operating systems in a graphical menu. The
	  selection is then booted with kexec.
```

## br2-external-ftdev/package/extra/nodm/Config.in
```kconfig
config BR2_PACKAGE_NODM
	bool "nodm"
	select BR2_PACKAGE_LINUX_PAM
	select BR2_PACKAGE_XAPP_XINIT
	help
	  nodm is an automatic display manager which automatically starts an X
	  session at system boot.

	  http://www.enricozini.org/sw/nodm/
```

## br2-external-ftdev/package/extra/qemu-i386-libc/Config.in
```kconfig
config BR2_PACKAGE_QEMU_I386_LIBC
	bool "qemu-i386-libc"
	help
	  i386 libc for use with qemu
```

## br2-external-ftdev/package/fonts/freefont-ttf/Config.in
```kconfig
config BR2_PACKAGE_FREEFONT_TTF
	bool "freefont TTF fonts"
	help
		Freefont is a set of free high-quality OpenType fonts
		covering the UCS character set. These fonts are similar
		to the widely known Helvetica, Times and Courier fonts.
```

## br2-external-ftdev/package/l4t/Config.in
```kconfig
if BR2_ARM_CPU_ARMV7A
menu "Linux4Tegra modules"
source "$BR2_EXTERNAL/package/l4t/nvidia-drivers/Config.in"
source "$BR2_EXTERNAL/package/l4t/nvidia-gst/Config.in"
source "$BR2_EXTERNAL/package/l4t/cuda/Config.in"
source "$BR2_EXTERNAL/package/l4t/cuda-cross-toolchain/Config.in.host"
source "$BR2_EXTERNAL/package/l4t/cuda-samples/Config.in"
source "$BR2_EXTERNAL/package/l4t/cudnn/Config.in"
source "$BR2_EXTERNAL/package/l4t/cudnn-samples/Config.in"
source "$BR2_EXTERNAL/package/l4t/nvidia-islandgl/Config.in"
source "$BR2_EXTERNAL/package/l4t/opencv4tegra/Config.in"
source "$BR2_EXTERNAL/package/l4t/nvidia-tegrastats/Config.in"
source "$BR2_EXTERNAL/package/l4t/visionworks/Config.in"
source "$BR2_EXTERNAL/package/l4t/libnvxio/Config.in"
source "$BR2_EXTERNAL/package/l4t/visionworks-samples/Config.in"
source "$BR2_EXTERNAL/package/l4t/visionworks-sfm/Config.in"
source "$BR2_EXTERNAL/package/l4t/visionworks-sfm-samples/Config.in"
source "$BR2_EXTERNAL/package/l4t/visionworks-tracking/Config.in"
source "$BR2_EXTERNAL/package/l4t/visionworks-tracking-samples/Config.in"
endmenu
endif

comment "Linux4Tegra modules are only available for ARMv7"
	depends on !BR2_ARM_CPU_ARMV7A
```

## br2-external-ftdev/package/l4t/cuda-cross-toolchain/Config.in.host
```kconfig
config BR2_HOST_CUDA_CROSS_TOOLCHAIN
	bool "cuda cross-compiling host toolchain"
	# CUDA cross toolchain is available for x86_64 only
	depends on BR2_HOSTARCH = "x86_64"
	# nvcc doesn't like gcc >= 4.9
	depends on BR2_GCC_VERSION_4_5_X || BR2_GCC_VERSION_4_7_X || BR2_GCC_VERSION_4_8_X

	help
		Cross-compiling CUDA host toolchain with nvcc and
		companion tools, and header files

comment "CUDA toolchain requires host arch x86_64 and gcc <= 4.8"
	depends on BR2_PACKAGE_CUDA && (BR2_HOSTARCH != "x86_64" || !BR2_GCC_VERSION_4_5_X && !BR2_GCC_VERSION_4_7_X && !BR2_GCC_VERSION_4_8_X)
```

## br2-external-ftdev/package/l4t/cuda-samples/Config.in
```kconfig
config BR2_PACKAGE_CUDA_SAMPLES
	bool "cuda-samples"
	select BR2_PACKAGE_CUDA
	select BR2_PACKAGE_LIBGLU
	select BR2_PACKAGE_LIBGLEW
	select BR2_PACKAGE_LIBFREEGLUT
	select BR2_PACKAGE_XLIB_LIBX11
	select BR2_PACKAGE_XLIB_LIBXI
	select BR2_PACKAGE_XLIB_LIBXMU
	depends on BR2_PACKAGE_HAS_LIBGL
	depends on BR2_HOST_CUDA_CROSS_TOOLCHAIN
	help
		CUDA example programs by NVIDIA

comment "cuda-samples require libgl and cuda cross-compiling host toolchain"
	depends on !BR2_PACKAGE_HAS_LIBGL || !BR2_HOST_CUDA_CROSS_TOOLCHAIN
```

## br2-external-ftdev/package/l4t/cudnn-samples/Config.in
```kconfig
config BR2_PACKAGE_CUDNN_SAMPLES
	bool "cudnn-samples"
	depends on BR2_PACKAGE_CUDNN
	select BR2_PACKAGE_CUDA
	select BR2_PACKAGE_LIBFREEIMAGE
	default y
	help
	  The NVIDIA CUDA Deep Neural Network library (cuDNN) is a
	  GPU-accelerated library of primitives for deep neural
	  networks.

	  This packages provides example programs demonstrating the
	  features of libcuDNN.
```

## br2-external-ftdev/package/l4t/cudnn/Config.in
```kconfig
config BR2_PACKAGE_CUDNN
	bool "cudnn"
	select BR2_PACKAGE_CUDA
	help
	  The NVIDIA CUDA Deep Neural Network library (cuDNN) is a
	  GPU-accelerated library of primitives for deep neural
	  networks.
```

## br2-external-ftdev/package/l4t/libnvxio/Config.in
```kconfig
config BR2_PACKAGE_LIBNVXIO
	bool "libnvxio"
	select BR2_PACKAGE_CUDA
	select BR2_PACKAGE_FREETYPE
	select BR2_PACKAGE_EIGEN
	select BR2_PACKAGE_LIBGLFW
	select BR2_PACKAGE_GSTREAMER1
	select BR2_PACKAGE_GST1_PLUGINS_BASE
	select BR2_PACKAGE_GST1_PLUGINS_BASE_PLUGIN_APP
	select BR2_PACKAGE_GST1_PLUGINS_GOOD
	select BR2_PACKAGE_GST1_PLUGINS_GOOD_PLUGIN_ISOMP4
	select BR2_PACKAGE_GST1_PLUGINS_BAD
	select BR2_PACKAGE_GST1_PLUGINS_BAD_PLUGIN_AUTOCONVERT
	select BR2_PACKAGE_GST1_PLUGINS_BAD_PLUGIN_VIDEOPARSERS
	select BR2_PACKAGE_GST1_PLUGINS_BAD_PLUGIN_BAYER
	select BR2_PACKAGE_FREEFONT_TTF
	depends on BR2_PACKAGE_VISIONWORKS
	depends on BR2_PACKAGE_HAS_LIBGL
	depends on BR2_PACKAGE_MESA3D
	help
		libnvxio is a helper library used by NVIDIA VisionWorks
		example applications.
```

## br2-external-ftdev/package/l4t/nvidia-drivers/Config.in
```kconfig
config BR2_PACKAGE_NVIDIA_DRIVERS
	bool "nvidia-drivers"
	help
		Binary drivers package with Linux4Tegra

		https://developer.nvidia.com/linux-tegra-rel-21
```
