## br2-external-ftdev/package/l4t/nvidia-gst/Config.in
```kconfig
config BR2_PACKAGE_NVIDIA_GST
	bool "nvidia-gst"
	depends on BR2_PACKAGE_GSTREAMER || BR2_PACKAGE_GSTREAMER1
	depends on !BR2_PACKAGE_GST_OMX
	help
		Gstreamer plugins and sample apps from nvidia/linux4tegra.

		https://developer.nvidia.com/linux-tegra-rel-21

comment "Nvidia GStreamer plugins need GStreamer 0.10 or 1.0"
	depends on !BR2_PACKAGE_GSTREAMER && !BR2_PACKAGE_GSTREAMER1

comment "Nvidia GStreamer plugins conflict gst-omx"
	depends on BR2_PACKAGE_GST_OMX
```

## br2-external-ftdev/package/l4t/nvidia-islandgl/Config.in
```kconfig
config BR2_PACKAGE_NVIDIA_ISLANDGL
	bool "Nvidia IslandGL demo"
	select BR2_PACKAGE_NVIDIA_DRIVERS
	help
		The Nvidia Island GL demo application
```

## br2-external-ftdev/package/l4t/nvidia-tegrastats/Config.in
```kconfig
config BR2_PACKAGE_NVIDIA_TEGRASTATS
	bool "tegrastats"
	help
		The tegrastats system monitoring utility as distributed
		with L4T.

		https://developer.nvidia.com/linux-tegra-rel-21
```

## br2-external-ftdev/package/l4t/opencv4tegra/Config.in
```kconfig
config BR2_PACKAGE_OPENCV4TEGRA
	bool "opencv4tegra"
	select BR2_PACKAGE_CUDA
	select BR2_PACKAGE_LIBPNG12
	select BR2_PACKAGE_JPEG
	select BR2_PACKAGE_TIFF
	select BR2_PACKAGE_JASPER
	select BR2_PACKAGE_FFMPEG12
	select BR2_PACKAGE_FFMPEG12_SWSCALE
	select BR2_PACKAGE_LIBGTK2
	select BR2_PACKAGE_LIBTBB
	depends on BR2_arm
	depends on !BR2_PACKAGE_OPENCV
	help
		OpenCV4Tegra binary libraries and utilities
		provided by NVIDIA with optimizations for tegra and CUDA
		support.

comment "opencv4tegra conflicts with opencv"
	depends on BR2_arm
	depends on BR2_PACKAGE_OPENCV
```

## br2-external-ftdev/package/l4t/visionworks-samples/Config.in
```kconfig
config BR2_PACKAGE_VISIONWORKS_SAMPLES
	bool "visionworks-samples"
	default y
	select BR2_PACKAGE_CUDA
	select BR2_PACKAGE_EIGEN
	select BR2_PACKAGE_LIBGLFW
	select BR2_PACKAGE_OPENCV4TEGRA
	select BR2_PACKAGE_LIBNVXIO
	depends on BR2_PACKAGE_VISIONWORKS
	help
		NVIDIA VisionWorks Toolkit is a CUDA accelerated
		software development package for computer vision (CV)
		and image processing. The toolkit is designed to
		provide a production-quality, standard interface that
		implements and extends the OpenVX standard, enabling
		high performance computer vision applications on NVIDIA
		Tegra devices.

		This package provides VisionWorks demo applications.

		https://developer.nvidia.com/embedded/visionworks
```

## br2-external-ftdev/package/l4t/visionworks-sfm-samples/Config.in
```kconfig
config BR2_PACKAGE_VISIONWORKS_SFM_SAMPLES
	bool "visionworks-sfm-samples"
	default y
	select BR2_PACKAGE_EIGEN
	select BR2_PACKAGE_CUDA
	select BR2_PACKAGE_LIBNVXIO
	depends on BR2_PACKAGE_VISIONWORKS
	depends on BR2_PACKAGE_VISIONWORKS_SFM
	help
		NVIDIA VisionWorks Plus (SFM) contains platform specific
		optimized libraries, including SFM, a library of
		computer vision primitives and algorithms with framework
		optimized for NVIDIA platforms built on top of NVIDIA
		VisionWorks and extends its API.

		https://developer.nvidia.com/embedded/visionworks
```

## br2-external-ftdev/package/l4t/visionworks-sfm/Config.in
```kconfig
config BR2_PACKAGE_VISIONWORKS_SFM
	bool "visionworks-sfm"
	default y
	select BR2_PACKAGE_CUDA
	depends on BR2_PACKAGE_VISIONWORKS
	help
		NVIDIA VisionWorks Plus (SFM) contains platform specific
		optimized libraries, including SFM, a library of
		computer vision primitives and algorithms with framework
		optimized for NVIDIA platforms built on top of NVIDIA
		VisionWorks and extends its API.

		https://developer.nvidia.com/embedded/visionworks
```

## br2-external-ftdev/package/l4t/visionworks-tracking-samples/Config.in
```kconfig
config BR2_PACKAGE_VISIONWORKS_TRACKING_SAMPLES
	bool "visionworks-tracking-samples"
	default y
	select BR2_PACKAGE_LIBNVXIO
	depends on BR2_PACKAGE_VISIONWORKS
	depends on BR2_PACKAGE_VISIONWORKS_TRACKING
	help
		NVIDIA(R) VisionWorks(TM) Object Tracker is a library of
		computer vision primitives with framework optimized for
		NVIDIA platforms built on top of NVIDIA(R)
		VisionWorks(TM) and extends its API. VisionWorks Object
		Tracker provides general Object Tracker interface and
		implements Keypoint Object Tracker algorithm.

		https://developer.nvidia.com/embedded/visionworks
```

## br2-external-ftdev/package/l4t/visionworks/Config.in
```kconfig
config BR2_PACKAGE_VISIONWORKS
	bool "visionworks"
	select BR2_PACKAGE_CUDA
	help
		NVIDIA VisionWorks Toolkit is a CUDA accelerated
		software development package for computer vision (CV)
		and image processing. The toolkit is designed to
		provide a production-quality, standard interface that
		implements and extends the OpenVX standard, enabling
		high performance computer vision applications on NVIDIA
		Tegra devices.

		https://developer.nvidia.com/embedded/visionworks
```

## br2-external-ftdev/package/lib/Config.in
```kconfig
source "$BR2_EXTERNAL/package/lib/libpng12/Config.in"
source "$BR2_EXTERNAL/package/lib/ffmpeg12/Config.in"
source "$BR2_EXTERNAL/package/lib/libtbb/Config.in"
```

## br2-external-ftdev/package/lib/ffmpeg12/Config.in
```kconfig
menuconfig BR2_PACKAGE_FFMPEG12
	bool "ffmpeg12"
	help
	  FFmpeg is a complete, cross-platform solution to record, convert
	  and stream audio and video.

	  http://www.ffmpeg.org

if BR2_PACKAGE_FFMPEG12

config BR2_PACKAGE_FFMPEG12_GPL
	bool "Enable GPL code"
	help
	  allow use of GPL code, the resulting libs and binaries will
	  be under GPL

config BR2_PACKAGE_FFMPEG12_NONFREE
	bool "Enable nonfree code"
	help
	  allow use of nonfree code, the resulting libs and binaries
	  will be unredistributable

config BR2_PACKAGE_FFMPEG12_FFMPEG
	bool "Build ffmpeg (the command line application)"
	select BR2_PACKAGE_FFMPEG12_SWSCALE
	depends on !BR2_PACKAGE_FFMPEG_FFMPEG
	default y
	help
	  FFmpeg is a very fast video and audio converter.
	  It can also grab from a live audio/video source.

	  It is not needed if you want to link the FFmpeg libraries
	  to your application.

comment "ffmpeg12 application ffmpeg conflicts with ffmpeg application ffmpeg"
	depends on BR2_PACKAGE_FFMPEG_FFMPEG

config BR2_PACKAGE_FFMPEG12_FFPLAY
	bool "Build ffplay"
	select BR2_PACKAGE_SDL
	depends on !BR2_PACKAGE_FFMPEG_FFPLAY
	help
	  FFplay is a very simple and portable media player using the
	  FFmpeg libraries and the SDL library.
	  It is mostly used as a testbed for the various FFmpeg APIs.

comment "ffmpeg12 application ffplay conflicts with ffmpeg application ffplay"
	depends on BR2_PACKAGE_FFMPEG_FFPLAY

config BR2_PACKAGE_FFMPEG12_FFSERVER
	bool "Build ffserver"
	depends on !BR2_PACKAGE_FFMPEG_FFSERVER
	help
	  FFserver is a streaming server for both audio and video.

comment "ffmeg12 application ffserver conflicts with ffmpeg application ffserver"
	depends on BR2_PACKAGE_FFMPEG_FFSERVER

config BR2_PACKAGE_FFMPEG12_POSTPROC
	bool "Build libpostproc"
	depends on BR2_PACKAGE_FFMPEG12_GPL
	help
	  Postproc is a library of video postprocessing routines.

config BR2_PACKAGE_FFMPEG12_SWSCALE
	bool "Build libswscale"
	help
	  Swscale is a library of video scaling routines.

config BR2_PACKAGE_FFMPEG12_ENCODERS
	string "Enabled encoders"
	default "all"
	help
	  Space-separated list of encoders to build in FFmpeg,
	  or "all" to build all of them.

	  Run ./configure --list-encoders in the ffmpeg sources
	  directory to know the available options.

config BR2_PACKAGE_FFMPEG12_DECODERS
	string "Enabled decoders"
	default "all"
	help
	  Space-separated list of decoders to build in FFmpeg,
	  or "all" to build all of them.

	  Run ./configure --list-decoders in the ffmpeg sources
	  directory to know the available options.

config BR2_PACKAGE_FFMPEG12_MUXERS
	string "Enabled muxers"
	default "all"
	help
	  Space-separated list of muxers to build in FFmpeg,
	  or "all" to build all of them.

	  Run ./configure --list-muxers in the ffmpeg sources
	  directory to know the available options.

config BR2_PACKAGE_FFMPEG12_DEMUXERS
	string "Enabled demuxers"
	default "all"
	help
	  Space-separated list of demuxers to build in FFmpeg,
	  or "all" to build all of them.

	  Run ./configure --list-demuxers in the ffmpeg sources
	  directory to know the available options.

config BR2_PACKAGE_FFMPEG12_PARSERS
	string "Enabled parsers"
	default "all"
	help
	  Space-separated list of parsers to build in FFmpeg,
	  or "all" to build all of them.

	  Run ./configure --list-parsers in the ffmpeg sources
	  directory to know the available options.

config BR2_PACKAGE_FFMPEG12_BSFS
	string "Enabled bitstreams"
	default "all"
	help
	  Space-separated list of bitstream filters to build in FFmpeg,
	  or "all" to build all of them.

	  Run ./configure --list-bsfs in the ffmpeg sources
	  directory to know the available options.

config BR2_PACKAGE_FFMPEG12_PROTOCOLS
	string "Enabled protocols"
	default "all"
	help
	  Space-separated list of protocols to build in FFmpeg,
	  or "all" to build all of them.

	  Run ./configure --list-protocols in the ffmpeg sources
	  directory to know the available options.

config BR2_PACKAGE_FFMPEG12_FILTERS
	string "Enabled filters"
	default "all"
	help
	  Space-separated list of filters to build in FFmpeg,
	  or "all" to build all of them.

	  Run ./configure --list-filters in the ffmpeg sources
	  directory to know the available options.

config BR2_PACKAGE_FFMPEG12_INDEVS
	bool "Enable input devices"
	default y

config BR2_PACKAGE_FFMPEG12_OUTDEVS
	bool "Enable output devices"
	default y

config BR2_PACKAGE_FFMPEG12_EXTRACONF
	string "Additional parameters for ./configure"
	default ""
	help
	  Extra parameters that will be appended to FFmpeg's
	  ./configure commandline.

endif
```

## br2-external-ftdev/package/lib/libpng12/Config.in
```kconfig
config BR2_PACKAGE_LIBPNG12
	bool "libpng12"
	select BR2_PACKAGE_ZLIB
	help
	  Some programs still link using the legacy -lpng12 version
	  of libpng for handling PNG (Portable Network Graphics)
	  images. It is still maintained for security fixes so
	  make it available, but do not select this unless you
	  have an application that explicitly needs the older
	  libpng12 functionality. Use libpng instead.

	  http://www.libpng.org/
```

## br2-external-ftdev/package/lib/libtbb/Config.in
```kconfig
config BR2_PACKAGE_LIBTBB
	bool "libtbb"
	depends on BR2_ARCH = "i686" || BR2_ARCH = "x86_64" || BR2_ARM_CPU_ARMV7A || BR2_ARCH = "powerpc" || BR2_ARCH = "sparc"
	help
	  The Intel Threading Building Blocks library for C++.

	  https://www.threadingbuildingblocks.org

comment "libtbb is not supported on target arch"
	depends on BR2_ARCH != "i686" && BR2_ARCH != "x86_64" && !BR2_ARM_CPU_ARMV7A && BR2_ARCH != "powerpc" && BR2_ARCH != "sparc"
```

## configs/ftdev_imx8_defconfig
```kconfig
BR2_aarch64=y
BR2_cortex_a72_a53=y
BR2_DL_DIR="$(HOME)/.dl"
BR2_TOOLCHAIN_BUILDROOT_GLIBC=y
BR2_PACKAGE_HOST_LINUX_HEADERS_CUSTOM_4_14=y
BR2_TOOLCHAIN_BUILDROOT_CXX=y
BR2_TARGET_GENERIC_GETTY_PORT="/dev/ttyLP1"
BR2_ROOTFS_OVERLAY="board/ftdev/imx8/rootfs_overlay"
BR2_ROOTFS_POST_BUILD_SCRIPT="board/ftdev/imx8/post-build.sh"
BR2_ROOTFS_POST_IMAGE_SCRIPT="board/ftdev/imx8/post-image.sh"
BR2_LINUX_KERNEL=y
BR2_LINUX_KERNEL_CUSTOM_GIT=y
BR2_LINUX_KERNEL_CUSTOM_REPO_URL="git://git.toradex.com/linux-toradex.git"
BR2_LINUX_KERNEL_CUSTOM_REPO_VERSION="fd0ec4d63feb9432e661be0424d15c4493599b30"
#BR2_LINUX_KERNEL_CUSTOM_REPO_VERSION="82a521bbb0c9704bf2c0ff08a8c0f69efa85a55f"
BR2_LINUX_KERNEL_USE_CUSTOM_CONFIG=y
BR2_LINUX_KERNEL_CUSTOM_CONFIG_FILE="board/ftdev/imx8/custom_files/ftdev-linux_defconfig_2"
BR2_LINUX_KERNEL_DTS_SUPPORT=y
BR2_LINUX_KERNEL_INTREE_DTS_NAME="freescale/fsl-imx8qm-apalis-eval freescale/fsl-imx8qm-apalis-ixora-v1.1"
BR2_LINUX_KERNEL_INSTALL_TARGET=y
BR2_PACKAGE_IPROUTE2=y
BR2_TARGET_ROOTFS_EXT2=y
BR2_TARGET_ROOTFS_EXT2_4=y
BR2_TARGET_ROOTFS_EXT2_SIZE="9g"
BR2_PACKAGE_HOST_GENIMAGE=y
```

## configs/ftdev_rpi3_qt_defconfig
```kconfig
BR2_arm=y
BR2_cortex_a53=y
BR2_ARM_FPU_NEON_VFPV4=y
BR2_DL_DIR="$(HOME)/dl"
BR2_OPTIMIZE_FAST=y
BR2_TOOLCHAIN_BUILDROOT_GLIBC=y
BR2_PACKAGE_HOST_LINUX_HEADERS_CUSTOM_4_14=y
BR2_TOOLCHAIN_BUILDROOT_CXX=y
BR2_GCC_ENABLE_LTO=y
BR2_ROOTFS_OVERLAY="board/ftdev/rpi3/rootfs_overlay"
BR2_ROOTFS_POST_BUILD_SCRIPT="board/ftdev/rpi3/post-build.sh"
BR2_ROOTFS_POST_IMAGE_SCRIPT="board/ftdev/rpi3/post-image.sh"
BR2_LINUX_KERNEL=y
BR2_LINUX_KERNEL_CUSTOM_GIT=y
BR2_LINUX_KERNEL_CUSTOM_REPO_URL="https://github.com/raspberrypi/linux.git"
BR2_LINUX_KERNEL_CUSTOM_REPO_VERSION="c117a8bccf37bfba323065b566cf999ed4629a4a"
BR2_LINUX_KERNEL_DEFCONFIG="bcm2709"
BR2_LINUX_KERNEL_DTS_SUPPORT=y
BR2_LINUX_KERNEL_INTREE_DTS_NAME="bcm2710-rpi-3-b"
BR2_PACKAGE_INCONSOLATA=y
BR2_PACKAGE_QT5=y
BR2_PACKAGE_QT5BASE_EGLFS=y
BR2_PACKAGE_QT5BASE_FONTCONFIG=y
BR2_PACKAGE_QT5BASE_PNG=y
BR2_PACKAGE_QT5SERIALPORT=y
BR2_PACKAGE_RPI_FIRMWARE=y
BR2_PACKAGE_RPI_USERLAND=y
# BR2_PACKAGE_IFUPDOWN_SCRIPTS is not set
BR2_TARGET_ROOTFS_EXT2=y
BR2_TARGET_ROOTFS_EXT2_4=y
BR2_TARGET_ROOTFS_EXT2_SIZE="100M"
BR2_PACKAGE_HOST_DOSFSTOOLS=y
BR2_PACKAGE_HOST_GENIMAGE=y
BR2_PACKAGE_HOST_MTOOLS=y
```

## configs/ftdev_tk1_minimal_defconfig
```kconfig
BR2_arm=y
BR2_cortex_a15=y
BR2_DL_DIR="$(HOME)/.dl"
BR2_CCACHE=y
BR2_CCACHE_DIR="$(HOME)/.dl/ccache/caches"
BR2_TOOLCHAIN_BUILDROOT_GLIBC=y
BR2_PACKAGE_HOST_LINUX_HEADERS_CUSTOM_3_10=y
BR2_TOOLCHAIN_BUILDROOT_CXX=y
BR2_TARGET_GENERIC_GETTY_PORT="ttyS0"
BR2_ROOTFS_OVERLAY="board/ftdev/tk1/rootfs_overlay"
BR2_ROOTFS_POST_BUILD_SCRIPT="board/ftdev/tk1/post-build.sh"
BR2_ROOTFS_POST_IMAGE_SCRIPT="board/ftdev/tk1/post-image.sh"
BR2_LINUX_KERNEL=y
BR2_LINUX_KERNEL_CUSTOM_GIT=y
BR2_LINUX_KERNEL_CUSTOM_REPO_URL="git://git.toradex.com/linux-toradex.git"
BR2_LINUX_KERNEL_CUSTOM_REPO_VERSION="ad44961f8b3cf5ce342d234c7eca05d89369c26b"
BR2_LINUX_KERNEL_DEFCONFIG="apalis-tk1"
BR2_LINUX_KERNEL_DTS_SUPPORT=y
BR2_LINUX_KERNEL_INTREE_DTS_NAME="tegra124-apalis-v1.2-eval tegra124-apalis-eval"
BR2_LINUX_KERNEL_INSTALL_TARGET=y
BR2_TARGET_ROOTFS_EXT2=y
BR2_TARGET_ROOTFS_EXT2_4=y
BR2_TARGET_ROOTFS_EXT2_SIZE="4096M"
BR2_PACKAGE_HOST_GENIMAGE=y
```
